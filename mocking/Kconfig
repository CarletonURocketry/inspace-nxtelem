## mocking/Kconfig
```kconfig
#
# For a description of the syntax of this configuration file,
# see the file kconfig-language.txt in the NuttX tools repository.
#

config INSPACE_MOCKING
	tristate "Sensor Mocking"
	depends on SENSORS_FAKESENSOR
	depends on UORB
	depends on SENSORS_GNSS
	default n
	---help---
		Enable mocking of sensors using test data

if INSPACE_MOCKING

comment "Program options"

config INSPACE_MOCKING_PROGNAME
	string "Program name"
	default "inspace_mock"
	---help---
		This is the name of the program that sets up sensor mocking.

comment "Mounting options"

config INSPACE_MOCKING_ROMFS
	bool "Use ROMFS file system"
	depends on BOARDCTL_ROMDISK
	depends on FS_ROMFS
	default y
	---help---
		Use the ROMFS file system to mount the CSV data for fake sensors.

config INSPACE_MOCKING_MOUNT
	string "ROMFS mount point"
	default "/inspace"
	depends on INSPACE_MOCKING_ROMFS
	---help---
		Where to mount the ROMFS containing the files in the test-data directory.

comment "Test data options"

config INSPACE_MOCKING_DATA_DIR
	string "Directory with fakesensor CSV files"
	default "test-data/quick-mock-flight"
	---help---
		The directory that contains the flight data to use for the fakesensors

if SENSORS_FAKESENSOR

menu "Faked Sensors"

config INSPACE_FAKE_BARO
	bool "Fake Barometic Sensor"
	default n
	---help---
		Create a fakesensor for barometric data

config INSPACE_FAKE_BARO_FILENAME
	string "Fake Barometric Sensor Input File"
	depends on INSPACE_FAKE_BARO
	default "/inspace/baro.csv"
	---help---
		The file to read fake barometric sensor data from

config INSPACE_FAKE_BARO_MAX_BATCH
	int "The maximum batch size of this sensor"
	depends on INSPACE_FAKE_BARO
	default 1
	---help---
		The maximum batch size of sensor measurements

config INSPACE_FAKE_ACCEL
	bool "Fake Acceleration Sensor"
	default n
	---help---
		Create a fakesensor for acceleration data

config INSPACE_FAKE_ACCEL_FILENAME
	string "Fake Acceleration Sensor Input File"
	depends on INSPACE_FAKE_ACCEL
	default "/inspace/accel.csv"
	---help---
		The file to read fake acceleration data from

config INSPACE_FAKE_ACCEL_MAX_BATCH
	int "The maximum batch size of this sensor"
	depends on INSPACE_FAKE_ACCEL
	default 1
	---help---
		The maximum batch size of sensor measurements

config INSPACE_FAKE_GYRO
	bool "Fake Gyroscope Sensor"
	default n
	---help---
		Create a fakesensor for gyroscope data

config INSPACE_FAKE_GYRO_FILENAME
	string "Fake Gyroscope Sensor Input File"
	depends on INSPACE_FAKE_GYRO
	default "/inspace/gyro.csv"
	---help---
		The file to read fake gyroscope data from

config INSPACE_FAKE_GYRO_MAX_BATCH
	int "The maximum batch size of this sensor"
	depends on INSPACE_FAKE_GYRO
	default 1
	---help---
		The maximum batch size of sensor measurements

config INSPACE_FAKE_MAG
	bool "Fake Magnetometer Sensor"
	default n
	---help---
		Create a fakesensor for magnetometer data

config INSPACE_FAKE_MAG_FILENAME
	string "Fake Magnetometer Sensor Input File"
	depends on INSPACE_FAKE_MAG
	default "/inspace/mag.csv"
	---help---
		The file to read fake magnetometer data from

config INSPACE_FAKE_MAG_MAX_BATCH
	int "The maximum batch size of this sensor"
	depends on INSPACE_FAKE_MAG
	default 1
	---help---
		The maximum batch size of sensor measurements

endmenu # Faked Sensors

endif # SENSORS_FAKESENSOR

endif
```

## sdcard-mounter/Kconfig
```kconfig
#
# For a description of the syntax of this configuration file,
# see the file kconfig-language.txt in the NuttX tools repository.
#

config INSPACE_SDCARD
	tristate "SD Card Mounter"
	default n
	---help---
		Enable the SD Card with partitions mounter.

if INSPACE_SDCARD

config INSPACE_SDCARD_PROGNAME
	string "Program name"
	default "inspace_mount"
	---help---
		This is the name of the program that will be used when the NSH ELF
		program is installed.

config INSPACE_SDCARD_PRIORITY
	int "SD Card mounter task priority"
	default 100

config INSPACE_SDCARD_STACKSIZE
	int "SD Card mounter stack size"
	default DEFAULT_TASK_STACKSIZE

endif
```

## selftest/Kconfig
```kconfig
#
# For a description of the syntax of this configuration file,
# see the file kconfig-language.txt in the NuttX tools repository.
#

config INSPACE_SELFTEST
	tristate "Josh self test"
	default n
	depends on TESTING_UNITY
	---help---
		Board self-test of all hardware to ensure hardware is working.

if INSPACE_SELFTEST

comment "Program options"

config INSPACE_SELFTEST_PROGNAME
	string "Program name"
	default "inspace_selftest"
	---help---
		This is the name of the program that self-tests Josh.

config INSPACE_SELFTEST_PRIORITY
    int "Selftest task priority"
    default 100

config INSPACE_SELFTEST_STACKSIZE
    int "Selftest system stack size"
    default DEFAULT_TASK_STACKSIZE

comment "Device paths"

config INSPACE_SELFTEST_RADIO
    string "Radio device"
    default "/dev/rn2483"
    ---help---
        The path identifier of the radio device for transmitting.

config INSPACE_SELFTEST_EEPROM
    string "Eeprom device"
    default "/dev/eeprom"
    ---help---
        The path identifier of the eeprom device for storing settings.

config INSPACE_SELFTEST_FLIGHT_FS
    string "Flight logging filesystem"
    default "/mnt/pwrfs"
    ---help---
        The path identifier of the filesystem to log data to during flight.

config INSPACE_SELFTEST_LANDED_FS
    string "Landing logging filesystem"
    default "/mnt/usrfs"
    ---help---
		The path identifier of the FAT filesystem where data is copied
		post-flight.

endif # INSPACE_SELFTEST
```

## telemetry/Kconfig
```kconfig
#
# For a description of the syntax of this configuration file,
# see the file kconfig-language.txt in the NuttX tools repository.
#

config INSPACE_TELEMETRY
    tristate "InSpace Telemetry System"
    default n
    depends on SENSORS
    depends on USENSOR
    depends on UORB
    ---help---
        Enable the Carleton University InSpace telemetry system code.

if INSPACE_TELEMETRY

comment "Program options"

config INSPACE_TELEMETRY_PROGNAME
    string "Program name"
    default "inspace_telem"
    ---help---
        This is the name of the program that will be used for the
        telemetry system application.

config INSPACE_TELEMETRY_PRIORITY
    int "Telemetry system task priority"
    default 100

config INSPACE_TELEMETRY_STACKSIZE
    int "Telemetry system stack size"
    default DEFAULT_TASK_STACKSIZE

config INSPACE_TELEMETRY_USBSH
	bool "USB shell thread"
	default y
	depends on CDCACM 
	depends on BOARDCTL_USBDEVCTRL
	depends on !ARCH_SIM
	---help---
		If the USB shell thread should be started, which allows access to the system
		while the application is running.

config INSPACE_TELEMETRY_N_JINGLES
	int "Startup jingle repititions"
	default 5
	range 0 100
	---help---
		How many times to play the startup jingle.

comment "Syslog output options"

config INSPACE_SYSLOG_OUTPUT
	bool "Enable syslog output"
	default n
	---help---
		Enables options for syslog outputs.

if INSPACE_SYSLOG_OUTPUT

config INSPACE_SYSLOG_PATH
	string "File path for redirected syslogging output"
	depends on INSPACE_SYSLOG_OUTPUT
	default "/mnt/pwrfs/syslog"
	---help---
		The path so save syslog output to, as well as printing to
		stdout

config INSPACE_SYSLOG_DEBUG
	bool "Debug logs enabled"
	default n
	---help---
		Enables granular debug logs.

config INSPACE_SYSLOG_INFO
	bool "Information logs enabled"
	depends on DEBUG_INFO
	default n
	---help---
		Enables informational logs.

config INSPACE_SYSLOG_WARN
	bool "Warning logs enabled"
	depends on DEBUG_WARN
	default n
	---help---
		Enables warning logs.

config INSPACE_SYSLOG_ERR
	bool "Error logs enabled"
	depends on DEBUG_ERROR
	default n
	---help---
		Enables error logs.

endif # INSPACE_SYSLOG_OUTPUT

comment "Logging options"

config INSPACE_TELEMETRY_STARTBUFFER
    int "Start buffering in seconds"
    default 20
    ---help---
        When the telemetry system starts, a rolling buffer of the last `n`
        seconds is kept up to date. This ensures that lift-off detection latency
        does not cause data loss about the initial lift-off.

config INSPACE_TELEMETRY_BUFFER_N_PACKETS
	int "Number of buffered packets"
	default 3
	range 0 128
	---help---
		The number of packets to buffer at a time in the packet queues.

config INSPACE_TELEMETRY_FS_SYNC_FREQ
	int "Flight filesystem sync frequency"
	default 3
	range 0 500
	---help---
		How many packets to write before syncing to the flight filesystem.

config INSPACE_TELEMETRY_FLIGHT_FS
    string "Flight logging filesystem"
    default "/mnt/pwrfs"
    ---help---
        The path identifier of the filesystem to log data to during flight.
        Should be a power-failure safe filesystem.

config INSPACE_TELEMETRY_LANDED_FS
    string "Landing logging filesystem"
    default "/mnt/usrfs"
    ---help---
        The path identifier of the filesystem to log data to after landing.
        Should be a FAT file system or something easily accessed from a host
        computer.

comment "EEPROM configuration settings"

config INSPACE_TELEMETRY_CALLSIGN
    string "HAM radio call sign"
    ---help---
        In order to transmit radio messages legally, an amateur radio call sign
        is required. This is used in the packet format transmitted by the
        telemetry system.

comment "Device paths"

config INSPACE_TELEMETRY_RADIO
    string "Radio device"
    default "/dev/rn2483"
    ---help---
        The path identifier of the radio device for transmitting.

config INSPACE_TELEMETRY_EEPROM
    string "Eeprom device"
    default "/dev/eeprom"
    ---help---
        The path identifier of the EEPROM device for storing settings.

config INSPACE_TELEMETRY_ADC
    string "Battery ADC device"
    default "/dev/adc0"
    ---help---
        The path identifier of the ADC device that measures battery voltage.

config INSPACE_TELEMETRY_EJECTLED
    string "Eject LED"
    default "/dev/gpio0"
    ---help---
        The path identifier of the GPIO which controls the EJECT LED.

config INSPACE_TELEMETRY_PWM
    string "PWM device"
    default "/dev/pwm0"
    ---help---
        The path identifier of the PWM buzzer.

comment "Sampling options"

config INSPACE_TELEMETRY_ACCEL_SF
	int "Accelerometer sampling frequency"
	default 100
	range 1 6600
	---help---
		The sampling frequency for the accelerometer in Hz

config INSPACE_TELEMETRY_GYRO_SF
	int "Gyroscope sampling frequency"
	default 100
	range 1 6600
	---help---
		The sampling frequency for the gyroscope in Hz

config INSPACE_TELEMETRY_MAG_SF
	int "Magnetometer sampling frequency"
	default 50
	range 1 50
	---help---
		The sampling frequency for the magnetometer in Hz

config INSPACE_TELEMETRY_BARO_SF
	int "Barometer sampling frequency"
	default 50
	range 1 100
	---help---
		The sampling frequency for the barometer in Hz

config INSPACE_TELEMETRY_GPS_SF
	int "GPS sampling frequency"
	default 10
	range 1 10
	---help---
		The sampling frequency for the GPS in Hz

config INSPACE_TELEMETRY_ALT_SF
	int "Altitude sampling frequency"
	default 25
	range 1 INSPACE_TELEMETRY_BARO_SF
	---help---
		The sampling frequency for fusion altitude

comment "Detection options"

config INSPACE_TELEMETRY_STALETIME
	int "Stale measurement time"
	default 1000000
	range 0 10000000
	---help---
		The time that measurements should be valid for when detecting flight
		states.

config INSPACE_TELEMETRY_ELEV_DELAY
	int "Elevation delay"
	default 100000
	range 0 10000000
	---help---
		The time on after initialization to take an altitude reading and use as
		the maximum landing altitude, in microseconds.

config INSPACE_TELEMETRY_LANDED_ALT_DURATION
	int "Landed altitude window duration"
	default 10000000
	range 0 100000000
	---help---
		The time in microseconds that altitude variation must be within the
		fluctuation limit for landing detection.

config INSPACE_TELEMETRY_APOGEE_ALT_THRESH
	int "Apogee altitude threshold"
	default 200
	---help---
		The altitude in centimeters below our maximum altitude while airborne we
		consider apogee to have been reached.

config INSPACE_TELEMETRY_APOGEE_ACCEL_THRESH
	int "Apogee accelerometer threshold"
	default 120
	range 0 320
	---help---
		The acceleration (magnitude) in centimeters per second squared above
		which we will not detect an apogee event. Should be around 0, since
		rocket is weightless at apogee.

config INSPACE_TELEMETRY_LANDED_ALT_WINDOW
	int "Landed altitude window size"
	default 50
	range 0 5000
	---help---
		The maximum amount the altitude can change by in centimeters to consider
		us landed.

config INSPACE_TELEMETRY_AIRBORNE_ALT_THRESH
	int "Airborne altitude threshold"
	default 200
	range 0 5000
	---help---
		The change in altitude when idle to enter the airborne state in
		centimeters.

config INSPACE_TELEMETRY_AIRBORNE_ACCEL_THRESH
	int "Airborne acceleration threshold"
	default 150
	range 0 320
	---help---
		The acceleration above which we consider the rocket to be flying in
		centimeters per second squared.

config INSPACE_TELEMETRY_ALT_MED_FILT_SIZE
	int "Altitude median filter size"
	default 5
	range 0 32
	---help---
		The number of samples the altitude median filter will use at a time.

config INSPACE_TELEMETRY_ACCEL_MED_FILT_SIZE
	int "Accleration median filter size"
	default 5
	range 0 32
	---help---
		The number of samples the acceleration median filter will use at a time.

config INSPACE_TELEMETRY_ALT_AVG_FILT_SIZE
	int "Altitude average filter size"
	default 5
	range 0 64
	---help---
		The number of samples the altitude average filter will use at a time.

config INSPACE_TELEMETRY_ACCEL_AVG_FILT_SIZE
	int "Accleration average filter size"
	default 5
	range 0 64
	---help---
		The number of samples the acceleration average filter will use at a
		time.

endif # INSPACE_TELEMETRY
```

## tests/Kconfig
```kconfig
#
# For a description of the syntax of this configuration file,
# see the file kconfig-language.txt in the NuttX tools repository.
#

config INSPACE_TESTS
	tristate "Test cases"
	select TESTING_UNITY
	select TESTING_UNITY_EXCLUDE_SETJMP
	depends on INSPACE_TELEMETRY
	default n
	---help---
		Build test cases

if INSPACE_TESTS

config INSPACE_TESTS_PROGNAME
	string "Program name"
	default "inspace_tests"
	---help---
		Name of the test executable

endif
```
